

float DataArr[] = {0,35.479937,98.733408,152.868914,189.989319,239.279718,297.688082,333.015413,326.987642,327.598047,338.737978,316.725161,238.59301,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290.7447,272.089121};

#define TTLPin 13

float threthord =  0.7;//閾値 (0~1)
int PulseLen = 10;   //パルス長[ms]

void setup() {
 pinMode(TTLPin,OUTPUT);
 Serial.begin(9600);
}

void loop() {
    float maxdata = 0;
    float data = 0;
    
    while(maxdata < 10){ //1000msの間の最大値を取る．一定以下の場合失敗とみなして再度
      for(int i = 0; i<127; i++){
        data = DataArr[i];
        delay(1);
        if(data > maxdata){
          maxdata = data;
        }
      }
    }
    //Serial.println(maxdata);

  int j = 0;
  int flag = 0;
  float data_f = 0;
  float data_f_before = 0;
  unsigned long before_time = millis();
  
  while(true){
    data_f = DataArr[j] / maxdata;
    
    if(data_f > threthord &&  millis() - before_time > 100){ //ノイズが来た時に連続して反応しないように7[Hz]の T = 140[ms],少なめに見積もって100[ms]経過しないと次のパルスを出さない
      before_time = millis();
      flag = 0;
      digitalWrite(TTLPin,HIGH);
      Serial.print(data_f);
      Serial.println(",1");
      delay(PulseLen);

    }else if(j > 255){
     j = 0;
     exit(0);

    }else if(millis() - before_time > 160 && flag == 0){ //前回パルス検出より160ms以上立ってたら検出エラーとみなし出力する
      before_time = millis();
      flag = 1;
      digitalWrite(TTLPin,HIGH);
      Serial.print(data_f);
      Serial.println(",1.2");
      delay(PulseLen);
    
    }else{
      Serial.print(data_f);
      Serial.println(",0");
      digitalWrite(TTLPin,LOW);
      delay(8);
      j++;
    }
  }
}
